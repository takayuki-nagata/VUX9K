## linux_workspace/buildroot/package/vux9k-bbtools/Config.in
```kconfig
config BR2_PACKAGE_VUX9K_BBTOOLS
	bool "vux9k-bbtools"
	depends on BR2_PACKAGE_BUSYBOX
	help
	  The text tools as small busyboxes on the card, one for each
	  use (vi and less; grep; sed; sort, uniq, cut, tr and tail;
	  awk; expr and dc; find, xargs, diff, cmp and stty), with
	  their applets' links in the initramfs
	  (linux_workspace/userland/bbtools/).
```

## linux_workspace/buildroot/package/vux9k-init/Config.in
```kconfig
config BR2_PACKAGE_VUX9K_INIT
	bool "vux9k-init"
	help
	  The initramfs' /init (linux_workspace/userland/init/): mounts
	  /dev, /proc and the SD card, starts the login shell again and
	  again, reaps orphans, and syncs and unmounts the card before a
	  reboot; in place of busybox init, which kept a whole copy of
	  busybox in RAM.
```

## linux_workspace/buildroot/package/vux9k-memprobe/Config.in
```kconfig
config BR2_PACKAGE_VUX9K_MEMPROBE
	bool "vux9k-memprobe"
	help
	  The largest free block of contiguous pages, allocated once
	  (linux_workspace/userland/memprobe/). VUX9K's noMMU userland
	  runs an executable only from such a block.
```

## linux_workspace/buildroot/package/vux9k-micropython/Config.in
```kconfig
config BR2_PACKAGE_VUX9K_MICROPYTHON
	bool "vux9k-micropython"
	help
	  MicroPython's unix port as a FLAT program on the card (MPY),
	  without threads, native code or networking, nothing frozen
	  in (linux_workspace/userland/micropython/variant/), and
	  bc_clone_py's modules compiled to .mpy for the card's
	  PYLIB.TAR. Not buildroot's micropython package, which needs
	  threads and shared libraries.
```

## linux_workspace/buildroot/package/vux9k-scripts/Config.in
```kconfig
config BR2_PACKAGE_VUX9K_SCRIPTS
	bool "vux9k-scripts"
	help
	  Sample shell scripts for the card
	  (linux_workspace/userland/scripts/): meminfo, the free
	  memory and its largest block; ledctl, the LEDs' triggers
	  and sysmon's mode; pylib, MicroPython's modules extracted
	  from the card's archive; python, MicroPython's launcher.
```

## linux_workspace/buildroot/package/vux9k-sysmon/Config.in
```kconfig
config BR2_PACKAGE_VUX9K_SYSMON
	bool "vux9k-sysmon"
	help
	  The system monitor on the board's LEDs
	  (linux_workspace/userland/sysmon/): Rust, no_std, with a
	  small C main.
```
