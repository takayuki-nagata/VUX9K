## zephyr_workspace/Kconfig
```kconfig
# Copyright (c) 2026 Takayuki Nagata
# SPDX-License-Identifier: Apache-2.0

rsource "soc/vux9k/vux9k/Kconfig"
```

## zephyr_workspace/boards/riscv/vux9k/Kconfig.board
```kconfig
# Copyright (c) 2026 Takayuki Nagata
# SPDX-License-Identifier: Apache-2.0

config BOARD_VUX9K
	bool "VUX9K Dual-ISA RISC-V RV32I SoC"
	depends on SOC_RISCV_VUX9K || SOC_SERIES_RISCV_VUX9K || SOC_RISCV32_CUSTOM || RISCV
	select SOC_SERIES_RISCV_VUX9K
```

## zephyr_workspace/boards/riscv/vux9k/Kconfig.defconfig
```kconfig
# Copyright (c) 2026 Takayuki Nagata
# SPDX-License-Identifier: Apache-2.0

if BOARD_VUX9K

config BOARD
	default "vux9k"

config SYS_CLOCK_HW_CYCLES_PER_SEC
	default 27000000

endif # BOARD_VUX9K
```

## zephyr_workspace/boards/riscv/vux9k/vux9k_defconfig
```kconfig
# Copyright (c) 2026 Takayuki Nagata
# SPDX-License-Identifier: Apache-2.0

CONFIG_SOC_SERIES_RISCV_VUX9K=y
CONFIG_SOC_VUX9K=y
CONFIG_BOARD_VUX9K=y

CONFIG_RISCV_ISA_RV32I=y
CONFIG_RISCV_ISA_EXT_M=n
CONFIG_RISCV_ISA_EXT_A=n
CONFIG_RISCV_ISA_EXT_C=n
CONFIG_RISCV_ISA_EXT_ZICSR=y

CONFIG_ATOMIC_OPERATIONS_C=y
CONFIG_RISCV_MACHINE_TIMER=y
CONFIG_SYS_CLOCK_HW_CYCLES_PER_SEC=27000000

CONFIG_SERIAL=y
CONFIG_UART_VUX9K=y
CONFIG_CONSOLE=y
CONFIG_UART_CONSOLE=y
CONFIG_PRINTK=y
CONFIG_EARLY_CONSOLE=y
```

## zephyr_workspace/boards/vux9k/vux9k/Kconfig.defconfig
```kconfig
# Copyright (c) 2026 Takayuki Nagata
# SPDX-License-Identifier: Apache-2.0

if BOARD_VUX9K

config BOARD
	default "vux9k"

endif # BOARD_VUX9K
```

## zephyr_workspace/boards/vux9k/vux9k/Kconfig.vux9k
```kconfig
# Copyright (c) 2026 Takayuki Nagata
# SPDX-License-Identifier: Apache-2.0

config BOARD_VUX9K
	select SOC_VUX9K
```

## zephyr_workspace/boards/vux9k/vux9k/vux9k_defconfig
```kconfig
# Copyright (c) 2026 Takayuki Nagata
# SPDX-License-Identifier: Apache-2.0

CONFIG_SYS_CLOCK_TICKS_PER_SEC=100
CONFIG_SYS_CLOCK_HW_CYCLES_PER_SEC=50000000
CONFIG_RISCV_MACHINE_TIMER=y

CONFIG_SERIAL=y
CONFIG_UART_VUX9K=y
CONFIG_CONSOLE=y
CONFIG_UART_CONSOLE=y
CONFIG_PRINTK=y
CONFIG_EARLY_CONSOLE=y

# Stack Size Configuration for Arbitrary-Precision Math
CONFIG_MAIN_STACK_SIZE=32768
CONFIG_IDLE_STACK_SIZE=512
CONFIG_ISR_STACK_SIZE=1024
```

## zephyr_workspace/drivers/serial/Kconfig
```kconfig
# Copyright (c) 2026 Takayuki Nagata
# SPDX-License-Identifier: Apache-2.0

menuconfig UART_VUX9K
	bool "VUX9K MMIO UART driver"
	default y
	depends on DT_HAS_VUX9K_UART_ENABLED
	select SERIAL_HAS_DRIVER
	select SERIAL_SUPPORT_INTERRUPT
	help
	  Enable the VUX9K MMIO UART driver for Tang Nano 9K SoC.
```

## zephyr_workspace/dts/bindings/interrupt-controller/vux9k,meip-intc.yaml
```yaml
# Copyright (c) 2026 Takayuki Nagata
# SPDX-License-Identifier: Apache-2.0

description: |
  The VUX9K's machine external interrupt (mcause 11) as a two-cell interrupt controller, so
  that drivers which read a priority cell (litex,uart0) can name it. No driver: without
  CONFIG_MULTI_LEVEL_INTERRUPTS the irq cell is the RISC-V interrupt number itself.

compatible: "vux9k,meip-intc"

include: [interrupt-controller.yaml, base.yaml]

properties:
  "#interrupt-cells":
    const: 2

interrupt-cells:
  - irq
  - priority
```

## zephyr_workspace/dts/bindings/serial/vux9k,uart.yaml
```yaml
# Copyright (c) 2026 Takayuki Nagata
# SPDX-License-Identifier: Apache-2.0

description: VUX9K MMIO UART Controller

compatible: "vux9k,uart"

include: [uart-controller.yaml, base.yaml]

properties:
  reg:
    required: true
```

## zephyr_workspace/soc/riscv/vux9k/Kconfig.defconfig.vux9k
```kconfig
# Copyright (c) 2026 Takayuki Nagata
# SPDX-License-Identifier: Apache-2.0

if SOC_SERIES_RISCV_VUX9K

config SOC_SERIES
	default "vux9k"

config SOC
	default "vux9k"

config RISCV_GENERIC_TOOLCHAIN
	default y

endif # SOC_SERIES_RISCV_VUX9K
```

## zephyr_workspace/soc/riscv/vux9k/Kconfig.series
```kconfig
# Copyright (c) 2026 Takayuki Nagata
# SPDX-License-Identifier: Apache-2.0

config SOC_SERIES_RISCV_VUX9K
	bool "VUX9K Series SoC"
	select RISCV
	select SOC_FAMILY_RISCV
	help
	  Enable support for VUX9K SoC series.
```

## zephyr_workspace/soc/riscv/vux9k/Kconfig.soc
```kconfig
# Copyright (c) 2026 Takayuki Nagata
# SPDX-License-Identifier: Apache-2.0

choice
	prompt "VUX9K SoC Implementation"
	depends on SOC_SERIES_RISCV_VUX9K

config SOC_VUX9K
	bool "VUX9K RV32I Dual-ISA SoC"
	select INCLUDE_RESET_VECTOR
	select RISCV_ISA_RV32I
	select RISCV_ISA_EXT_ZICSR

endchoice
```

## zephyr_workspace/soc/vux9k/vux9k/Kconfig
```kconfig
# Copyright (c) 2026 Takayuki Nagata
# SPDX-License-Identifier: Apache-2.0

config SOC_FAMILY_VUX9K
	bool

config SOC_SERIES_VUX9K
	bool
	select SOC_FAMILY_VUX9K
```

## zephyr_workspace/soc/vux9k/vux9k/Kconfig.defconfig
```kconfig
# Copyright (c) 2026 Takayuki Nagata
# SPDX-License-Identifier: Apache-2.0

if SOC_VUX9K

config SYS_CLOCK_HW_CYCLES_PER_SEC
	default 50000000

config NUM_IRQS
	default 16

config RISCV_GP
	default n

endif # SOC_VUX9K
```
