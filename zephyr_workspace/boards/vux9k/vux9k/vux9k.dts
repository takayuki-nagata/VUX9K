/*
 * Copyright (c) 2026 Takayuki Nagata
 * SPDX-License-Identifier: Apache-2.0
 */

/dts-v1/;

#include "vux9k-common.dtsi"

/ {
	model = "VUX9K Tang Nano 9K SoC";

	soc {
		/*
		 * The PSRAM 0x8000_0000-0x803F_FFFF: the image, run in place (XIP). The second
		 * stage's `run` loads a v4 file there (load address 0x8000_0000) and jumps to it;
		 * its window ends at 0x8070_0000, the second stage's own.
		 */
		flash0: flash@80000000 {
			compatible = "soc-nv-flash";
			reg = <0x80000000 DT_SIZE_M(4)>;
		};

		/*
		 * The PSRAM 0x8040_0000-0x806F_FFFF: .data (copied from the image at start-up),
		 * .bss, stacks. Its top 64 KB is the first stage's data, which the first stage
		 * sets up again when it starts. I-RAM (the first stage) and D-RAM are not used.
		 */
		sram0: memory@80400000 {
			compatible = "mmio-sram";
			reg = <0x80400000 DT_SIZE_M(3)>;
		};
	};
};
