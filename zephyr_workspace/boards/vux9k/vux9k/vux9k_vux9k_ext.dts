/*
 * Copyright (c) 2026 Takayuki Nagata
 * SPDX-License-Identifier: Apache-2.0
 *
 * Emulator only (vux9k-emu --profile extended): NOT real hardware.
 */

/dts-v1/;

#include "vux9k-common.dtsi"

/ {
	model = "VUX9K SoC, extended memory (emulator only, NOT real hardware)";

	soc {
		flash0: flash@0 {
			compatible = "soc-nv-flash";
			reg = <0x00000000 DT_SIZE_K(512)>;
		};

		sram0: memory@20000000 {
			compatible = "mmio-sram";
			reg = <0x20000000 DT_SIZE_K(256)>;
		};
	};
};
