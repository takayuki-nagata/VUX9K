## CMakeLists.txt
```
# Copyright (c) 2026 Takayuki Nagata
# SPDX-License-Identifier: Apache-2.0

cmake_minimum_required(VERSION 3.20.0)

find_package(Zephyr REQUIRED HINTS $ENV{ZEPHYR_BASE})
project(vux9k_zephyr_rust)

# The Rust part (rust_demo/) is a staticlib for RV32IM, built by cargo into this
# build directory; cargo itself decides whether anything changed (ALL + always run).
set(RUST_TARGET riscv32im-unknown-none-elf)
set(RUST_TARGET_DIR ${CMAKE_BINARY_DIR}/rust_demo)
set(RUST_LIB ${RUST_TARGET_DIR}/${RUST_TARGET}/release/libvux9k_rust_demo.a)

add_custom_target(rust_demo_staticlib
    # Line tables only (for make coverage-fw): no code change, nothing in zephyr.bin
    COMMAND ${CMAKE_COMMAND} -E env CARGO_TARGET_DIR=${RUST_TARGET_DIR} CARGO_PROFILE_RELEASE_DEBUG=line-tables-only
            cargo build --release --target ${RUST_TARGET}
    WORKING_DIRECTORY ${CMAKE_CURRENT_SOURCE_DIR}/rust_demo
    BYPRODUCTS ${RUST_LIB}
    COMMENT "Building the rust_demo staticlib for RV32IM"
)

target_sources(app PRIVATE src/main.c)
add_dependencies(app rust_demo_staticlib)
target_link_libraries(app PRIVATE ${RUST_LIB})
```

## prj.conf
```kconfig
# Copyright (c) 2026 Takayuki Nagata
# SPDX-License-Identifier: Apache-2.0

# The Rust demo runs on the real board (-b vux9k), from the PSRAM, where a fetch that misses
# the instruction cache waits ~49 cycles: these settings keep it small (they once made it fit
# the 14 KB of I-RAM the board was linked into), and so quick to load with the second stage's `run`.
CONFIG_PRINTK=y
CONFIG_CONSOLE=y
CONFIG_UART_CONSOLE=y
CONFIG_SERIAL=y
CONFIG_EARLY_CONSOLE=n
CONFIG_BOOT_BANNER=n

CONFIG_SIZE_OPTIMIZATIONS=y
CONFIG_MINIMAL_LIBC=y
CONFIG_CBPRINTF_NANO=y
CONFIG_EXCEPTION_DEBUG=n
CONFIG_TIMESLICING=n
CONFIG_HEAP_MEM_POOL_SIZE=0
CONFIG_ERRNO=n

CONFIG_MAIN_STACK_SIZE=1024
CONFIG_IDLE_STACK_SIZE=256
CONFIG_ISR_STACK_SIZE=512
```

## src/main.c
```c
/*
 * Copyright (c) 2026 Takayuki Nagata
 * SPDX-License-Identifier: Apache-2.0
 */

#include <stddef.h>
#include <stdint.h>
#include <zephyr/kernel.h>
#include <zephyr/sys/printk.h>

/* Wrapper functions for Rust FFI */
void vux9k_print_str(const char *str)
{
	printk("%s", str);
}

void vux9k_print_int(int32_t val)
{
	printk("%d", (int)val);
}

int32_t vux9k_k_msleep(int32_t ms)
{
	return k_msleep(ms);
}

uint32_t vux9k_k_uptime_get_32(void)
{
	return k_uptime_get_32();
}

/* Rust staticlib entry function */
extern void rust_main(void);

int main(void)
{
	printk("\n========================================\n");
	printk("  Zephyr RTOS Booting on VUX9K SoC!     \n");
	printk("  Dual-ISA (RV32IM & Hack) FPGA Platform\n");
	printk("========================================\n");

	printk("[Zephyr Kernel] Kernel initialized successfully.\n");
	printk("[Zephyr Kernel] Handing over execution to Rust application...\n");

	/* Call Rust application main entry */
	rust_main();

	printk("\n[Zephyr Kernel] Rust application returned. Entering sleep loop.\n");

	while (1) { /* cov:exclude(k_sleep(K_FOREVER) never returns to loop) */
		k_sleep(K_FOREVER);
	}

	return 0;
}
```
